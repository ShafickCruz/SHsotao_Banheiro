/*
 Name:		sotao_banheiro.ino
 Created:	29/01/2023 19:48:42
 Author:	Shafick Cruz
*/

/*
NTC B3950 Thermistor
--------------------
the formula for temp in kelvin is
                1
T = ----------------------------
    1/To + (1/beta) * ln(Rt/Ro)

https://en.wikipedia.org/wiki/Thermistor

ESP32 ADC non-liear issue
https://www.esp32.com/viewtopic.php?t=1045
https://github.com/espressif/esp-idf/issues/164
https://docs.espressif.com/projects/esp-idf/en/latest/api-reference/peripherals/adc.html#adc-calibration
*/

/*
* INFORMAÇÕES DESTE ESP32
Chip is ESP32-D0WDQ6 (revision v1.0)
Features: WiFi, BT, Dual Core, 240MHz, VRef calibration in efuse, Coding Scheme None
Crystal is 40MHz
MAC: 34:86:5d:3a:3c:70
*/

/*
MAC DO ESP32 BANHEIRA: CC : 7B : 5C : F0 : 88 : E4
0xcc, 0x7b, 0x5c, 0xf0, 0x88, 0xe4
*/

/*
RECONHECIMENTO DE COMANDOS
Toda comunicação deve ser precedida do texto de identificação em hexa
Após o identificador deve haver um ponto
Após o ponto deve haver o numero que identifica o comando
O texto (SH HOME) convertido para hexadecimal(String to Hex)
(Tem que ser tudo em maiusculo)
https://codebeautify.org/string-hex-converter
Ex. SH HOME.1 (534820484f4d45.0)
Desta forma saberá que é uma comunicação oficial para executar o comando 1
*/

// BIBLIOTECAS

/*
Dependency Graph
|-- SHtools_ESP32_OTA_AP @ 2.0.0+sha.705441c
|-- OneButton @ 2.6.1
|-- AsyncTCP @ 3.2.5
|-- ElegantOTA @ 3.1.5
|-- ESPAsyncWebServer @ 3.3.1
|-- WiFi @ 2.0.0
*/

#include <Arduino.h>
#include <WiFi.h>
#include <ElegantOTA.h>
#include <AsyncTCP.h>
#include <ESPAsyncWebServer.h>
#include <esp_now.h>
#include <OneButton.h>
#include <SHtools_ESP32_OTA_AP.h>

// GPIO
// -- input
#define PIN_DUCHE_LUZ_IN GPIO_NUM_39
#define PIN_DESCARGA_IN GPIO_NUM_36
#define PIN_AUDIO_IN GPIO_NUM_34
#define PIN_AQUECEDOR_IN GPIO_NUM_35
#define PIN_LUZ_AMBIENTE_IN GPIO_NUM_32
#define PIN_PIR GPIO_NUM_26
#define PIN_DUCHE_FLUXO GPIO_NUM_25
#define PIN_DUCHE_TEMPERATURA GPIO_NUM_33
#define PIN_RELE8_IN GPIO_NUM_16
#define PIN_RELE7_IN GPIO_NUM_21 // QUANDO FOR FAZER O HARDWARE DEFINITIVO, TROCAR O PINO 19 COM O 21
#define PIN_UPDATE GPIO_NUM_19   // POR QUESTÃO DE ORGANIZAÇÃO, POIS ASSIM O RELE7 USARÁ OS PINOS 18 E 19
                                 // AO INVÉS DE 18 E 21. E O BOTAO UPDATE PASSA DO 19 PARA O 21

// -- output
#define PIN_AQUECEDOR_OUT GPIO_NUM_27
#define PIN_AUDIO_OUT GPIO_NUM_14
#define PIN_DESCARGA_OUT GPIO_NUM_12
#define PIN_DUCHE_LUZ_OUT GPIO_NUM_13

#define PIN_LUZ_AMBIENTE_OUT GPIO_NUM_15
#define PIN_DUCHE_LEDS_OUT GPIO_NUM_4

#define PIN_BUZZER GPIO_NUM_5

#define PIN_RELE8_OUT GPIO_NUM_17
#define PIN_RELE7_OUT GPIO_NUM_18

// VARIAVEIS

// -- COMUNS
const int DEBOUNCE_DELAY = 150;                 // Tempo de debounce em milissegundos
const char comID[] = "534820484f4d45";          // Identificador de comando oficial
unsigned long restart_momentoInicial;           // Variável para armazenar o momento inicial
const unsigned long restart_periodo = 86400000; // 24 horas em milissegundos

// -- Endereço MAC em hexa do ESP32 com o qual este esp se emparelhará
static uint8_t PEER[]{0xcc, 0x7b, 0x5c, 0xf0, 0x88, 0xe4};

// -- DESCARGA
const int descarga_tempo1 = 7000;          // tempo de abertura/fechamento numero1
const int descarga_tempo2 = 10000;         // tempo de abertura/fechamento numero2
const int descarga_tempoMax = 15000;       // tempo maximo de abertura
const int descarga_tempoAlarme = 30000;    // tempo de alerta de pane
const int descarga_MargemSeguranca = 2000; // tempo de margem de segurança para fechamento
bool descarga_abrindo = false;
bool descarga_fechando = false;
bool descarga_habilitada = true;
bool descarga_ModoOnDemand = false;
unsigned long descarga_inicioTempoEspera = 0;
int descarga_tempoEspera = 0;

// -- LUZ AMBIENTE
unsigned long LuazAmbiente_contador = 0;           // Guarda o millis() atual somado ao tempo maximo que a luz ficará ligada
const int LuzAmbiente_tempoMax = 180000;           // tempo que a luz ambiente permanecerá acesa. Em millis
bool LuzAmbiente_UltimoEstado = LOW;               // guarda o ultimo estado da luz ambiente
unsigned long LuzAmbiente_UltimaMudanca = 0;       // guarda o momento da ultima mudança de estado da luz ambiente
bool LuzAmbiente_EstagioInicial = false;           // indica se é o estágio inicial de luz ambiente onde todas as luzes ambiente serão acesas
const int LuzAmbiente_EstagioInicial_tempo = 5000; // tempo em que todas as luzes ambiente permanecerão acesas no estagio inicial
unsigned long LuzAmbiente_EstagioInicial_UltimoON; // guarda o ultimo momento em que foram acesas

// ESTADO DOS RECURSOS
bool banheiraLed_ON = false;
bool audio_ON = false;
bool aquecedor_ON = false;
bool ducheLuz_ON = false;
bool ducheLed_ON = false;
bool rele7_on = false;
bool rele8_on = false;
bool descarga_ON = false;    // descarga em uso?
bool LuzAmbiente_ON = false; // luz ambiente ligada?

// -- PIR
unsigned long pir_ultimaLeitura = 0;   // guarda o momento da ultima leitura do pir
const int pir_intervaloLeitura = 3000; // intervalo entre elituras do pir

// -- SENSOR DE FLUXO
volatile int fluxo_numPulsos = 0;         // Contador de pulsos recebidos do sensor de fluxo
unsigned long fluxo_previousMillis = 0;   // Armazena o valor de millis() anterior
const int fluxo_intervaloLeituras = 1000; // Intervalo entre leituras. Em millis
const int fluxo_qntLeituras = 3;          // Quantidade de leituras a serem efetuada
const int fluxo_vazaoMinima = 2;          // Vazão mínima para definir chuveiro como ligado
bool chuveiroLigado = false;              // define se o chuveiro está ligado com basena media de leituras de vazão L/min

// -- SENSOR DE TEMPERATURA NTC50k
double ntc_adcMax, ntc_Vs;
double ntc_R1 = 51000.0;  // voltage divider resistor value (eu nao tinha de 50k)
double ntc_Beta = 3950.0; // Beta value
double ntc_To = 298.15;   // Temperature in Kelvin for 25 degree Celsius
double ntc_Ro = 50000.0;  // Resistance of Thermistor at 25 degree Celsius

unsigned long ntc_ultimoMillis = 0;
const long ntc_intervalo = 3000; // Intervalo de 3 segundos

#define ntc_WINDOW_SIZE 10
double ntc_readings[ntc_WINDOW_SIZE]; // as leituras do sensor
int ntc_currentIndex = 0;             // o índice atual na janela
double ntc_sum = 0;                   // a soma das leituras na janela

// The ESP32 lookup table varies from device to device, use the program from
// https://github.com/e-tinkers/esp32-adc-calibrate
// to generate lookup table for your own ESP32

const float ADC_LUT[4096] = {0,
                             97.6000, 100.0000, 102.6000, 105.0000, 107.6000, 110.0000, 112.4000, 114.0000, 115.4000, 117.0000, 118.4000, 120.0000, 121.4000, 123.0000, 124.4000,
                             126.0000, 127.6000, 128.8000, 129.8000, 130.8000, 131.8000, 132.6000, 133.6000, 134.6000, 135.4000, 136.4000, 137.2000, 138.2000, 139.2000, 140.0000,
                             141.0000, 142.0000, 143.0000, 144.0000, 145.0000, 146.2000, 147.6000, 148.8000, 149.8000, 150.8000, 152.0000, 153.0000, 154.2000, 155.4000, 156.8000,
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                             4029.3999, 4030.0000, 4030.6001, 4031.0000, 4031.6001, 4032.0000, 4033.6001, 4035.0000, 4037.0000, 4038.8000, 4040.3999, 4042.0000, 4043.8000, 4045.8000, 4047.20};

// ESPNOW
bool EspNowHabilitado = false;
bool EspNowEnvioOK = false;   // a mensagem foi enviada?
bool EspNowEntregaOK = false; // a mensagem foi enviada e entregue?

// INSTANCIAS

OneButton bt_descarga(PIN_DESCARGA_IN, false, false);
OneButton bt_ducheLuz(PIN_DUCHE_LUZ_IN, false, false);
OneButton bt_luzAmbiente(PIN_AQUECEDOR_IN, true, true);
OneButton bt_audio(PIN_AUDIO_IN, true, true);
OneButton bt_aquecedor(PIN_AQUECEDOR_IN, true, true);

SHtools_ESP32_OTA_AP FirmwareUpdate(LED_BUILTIN, PIN_UPDATE, "sotao_banheiro");

// FUNÇÕES

void COMANDOS(bool executar, int cmd, int arg1, int arg2, String argSTR);
void LuzAmbiente_Handler();
void LuzAmbiente_PIR();
void luz_banheira();
void Fluxo_handler();
void NTC_handler();
void IRAM_ATTR fluxo_contaPulsos();
void DESCARGA_numero1();
void DESCARGA_mumero2();
void DESCARGA_onDemand();
void DESCARGA_onDemand_fim();
void DESCARGA_handler();
void DESCARGA_ligar(byte modo);
void DESCARGA_desligar();
void DESCARGA_liberar();

bool EspNow_EnviarDadosComTimeout(const char *payload, unsigned long timeoutMs);
void EspNow_CallbackEnvioStatus(const uint8_t *mac_addr, esp_now_send_status_t status);
void EspNow_CallbackReceber(const uint8_t *mac_addr, const uint8_t *data, int len);

void interruptor_luzAmbiente();
void interruptor_audio();
void interruptor_aquecedor();
void interruptor_ducheLuz();

void setup()
{
    Serial.begin(115200);
    delay(1000);

    // -- input
    pinMode(PIN_DUCHE_LUZ_IN, INPUT);
    pinMode(PIN_DUCHE_FLUXO, INPUT);
    pinMode(PIN_DUCHE_TEMPERATURA, INPUT);
    pinMode(PIN_LUZ_AMBIENTE_IN, INPUT);
    pinMode(PIN_AUDIO_IN, INPUT);
    pinMode(PIN_AQUECEDOR_IN, INPUT);
    pinMode(PIN_DESCARGA_IN, INPUT);
    pinMode(PIN_PIR, INPUT_PULLDOWN);
    pinMode(PIN_UPDATE, INPUT_PULLUP);

    // -- output
    pinMode(PIN_DUCHE_LUZ_OUT, OUTPUT);
    pinMode(PIN_AUDIO_OUT, OUTPUT);
    pinMode(PIN_AQUECEDOR_OUT, OUTPUT);

    pinMode(PIN_DESCARGA_OUT, OUTPUT);
    pinMode(PIN_DUCHE_LEDS_OUT, OUTPUT);
    pinMode(PIN_BUZZER, OUTPUT);
    pinMode(LED_BUILTIN, OUTPUT);
    pinMode(PIN_LUZ_AMBIENTE_OUT, OUTPUT);

    // -- digitalWrite
    digitalWrite(PIN_DESCARGA_OUT, LOW);
    digitalWrite(PIN_LUZ_AMBIENTE_OUT, LOW);
    digitalWrite(PIN_DUCHE_LEDS_OUT, LOW);
    digitalWrite(PIN_BUZZER, LOW);
    digitalWrite(LED_BUILTIN, LOW);

    // inicia a biblioetca
    FirmwareUpdate.begin();

    // DESCARGA

    // Defina as funções callback para os clicks do botao descarga
    bt_descarga.attachClick(DESCARGA_numero1);
    bt_descarga.attachDoubleClick(DESCARGA_mumero2);
    bt_descarga.attachLongPressStart(DESCARGA_onDemand);
    bt_descarga.attachLongPressStop(DESCARGA_onDemand_fim);

    bt_descarga.setDebounceMs(50); // Mantém o debounce padrão
    bt_descarga.setClickMs(1000);  // Timeout used to distinguish single clicks from double clicks.
    bt_descarga.setPressMs(1500);  // Duration to hold a button to trigger a long press.

    bt_audio.attachClick(interruptor_audio);
    bt_aquecedor.attachClick(interruptor_aquecedor);
    bt_luzAmbiente.attachClick(interruptor_luzAmbiente);
    bt_ducheLuz.attachClick(interruptor_ducheLuz);

    // SENSOR DE FLUXO
    attachInterrupt(digitalPinToInterrupt(PIN_DUCHE_FLUXO), fluxo_contaPulsos, RISING); // Configura a interrupção

    // SENSOR DE TEMPERATURA NTC50k
    ntc_adcMax = 4095.0; // ADC resolution 12-bit (0-4095)
    ntc_Vs = 3.3;        // supply voltage

    /*
        ESP-NOW configuração
        WiFi must be powered on to use ESP-NOW unicast.
        It could be either AP or STA mode, and does not have to be connected.
        For best results, ensure both devices are using the same WiFi channel.
        */
    WiFi.persistent(false); // Desativa a persistência das configurações do Wi-Fi para proteger a memoria flash
    WiFi.mode(WIFI_STA);    // Configura o wifi para funcionar como STA (cliente)
    WiFi.disconnect();      // Convém desconectar de qualquer rede wifi antes de configurar o espnow
    delay(100);

    /* ESPNOW

        Tento iniciar o EspNow por 3 vezes e se não conseguir, reinicia o esp
        Após 3 reinicios do esp sem sucesso de iniciar o espnow,
        desabilito o espnow e rodo o codigo normalmente até o proximo reinicio,
        onde as tentativas de iniciar o espnow serão retomadas
    */
    for (int i = 0; i < 3; i++)
    {
        // inicializa o espnow com o canal definido no wifi
        // adicionando um parceiro, com possibilidade de definir uma chave criptografica que deve estar igual em ambos
        // const uint8_t chaveCriptografia[] = { 0x12, 0x34, 0x56, 0x78, 0x90, 0xAB, 0xCD, 0xEF }; // Substitua com sua chave
        // ok = WifiEspNow.addPeer(PEER, true, chaveCriptografia);

        if (esp_now_init() == ESP_OK) // tenta iniciar o espnow
        {
            // configura o peer
            esp_now_peer_info_t peerInfo;
            memset(&peerInfo, 0, sizeof(peerInfo));
            memcpy(peerInfo.peer_addr, PEER, 6); // PEER é o endereço MAC do parceiro
            peerInfo.channel = 1;                // Canal definido no Wi-Fi
            peerInfo.encrypt = false;            // Ajuste para criptografia, se necessário

            // tenta adicionar o peer
            if (esp_now_add_peer(&peerInfo) == ESP_OK)
            {
                // Define a função de callback para recebimento de dados
                esp_now_register_recv_cb(EspNow_CallbackReceber);
                // Define a função de callback para após o envio dos dados para informar o status do envio
                esp_now_register_send_cb(EspNow_CallbackEnvioStatus);

                EspNowHabilitado = true;
                break; // sai do loop for
            }
            else
            {
                Serial.println(F("Falha ao adicionar peer"));
            }
        }
        else
        {
            Serial.println(F("Falha ao inicializar o ESP-NOW"));
        }

        delay(2000);
        if (i == 2)
        { // Terceira tentativa falha
            EspNowHabilitado = false;
        }
    }

    // Led aceso indica que EspNow está ativo; apagado indica desabilitado
    digitalWrite(LED_BUILTIN, EspNowHabilitado);

    // Armazena o momento inicial para restart
    restart_momentoInicial = millis();
}

void loop()
{
    // processa as requisições da biblioteca
    FirmwareUpdate.handle();

    // se estiver em modo de update, não executa outras tarefas
    // if (FirmwareUpdate.get_ServerMode())
    //  return;

    // A cada 24h, verifica se o espnow está habilitado e caso não esteja, reinicia o esp32
    unsigned long currentMillis = millis();
    if (currentMillis - restart_momentoInicial >= restart_periodo)
    {
        if (EspNowHabilitado)
        {
            restart_momentoInicial = millis(); // renova o moment inicial do periodo
        }
        else
        {
            ESP.restart(); // Reinicia o ESP32
        }
    }

    // DESCARGA
    DESCARGA_handler();

    bt_ducheLuz.tick();
    bt_luzAmbiente.tick();
    bt_audio.tick();
    bt_aquecedor.tick();

    // SENSOR DE FLUXO E TEMPERATURA
    Fluxo_handler();

    // SENSOR DE TEMPERATURA NTC50K
    NTC_handler();

    // LEDS DUCHE
    // aciona o rele 6 que liga leds do nicho e da base da duche
    if (LuzAmbiente_EstagioInicial == false)
    {
        digitalWrite(PIN_DUCHE_LEDS_OUT, (chuveiroLigado) ? HIGH : LOW);
    }

    // LUZ AMBIENTE - PIR
    LuzAmbiente_PIR();

    // LUZ AMBIENTE
    LuzAmbiente_Handler();
}

// Função para enviar dados com timeout e retorno de sucesso ou falha
bool EspNow_EnviarDadosComTimeout(const char *payload, unsigned long timeoutMs)
{
    // Reseta as flags de status
    EspNowEnvioOK = false;
    EspNowEntregaOK = false;

    // Envia os dados via ESP-NOW
    if (esp_now_send(PEER, (const uint8_t *)payload, strlen(payload)) != ESP_OK)
    {
        Serial.println(F("Erro imediato ao tentar enviar os dados."));
        return false;
    }

    // Aguarda a confirmação do envio ou o timeout
    unsigned long tempoInicial = millis();
    while (!EspNowEnvioOK)
    { // Aguarda o callback de mensagem enviada ser chamado
        if ((millis() - tempoInicial) >= (timeoutMs * 1000))
        {
            Serial.println(F("Timeout: nenhuma resposta do peer."));
            return false;
        }
        delay(10); // Aguarda um pouco antes de verificar novamente
    }

    // Retorna se os dados foram enviados e recebidos
    return EspNowEntregaOK;
}

// Função de callback para verificar o status do envio (entrega)
void EspNow_CallbackEnvioStatus(const uint8_t *mac_addr, esp_now_send_status_t status)
{
    if (status == ESP_NOW_SEND_SUCCESS)
    {
        EspNowEntregaOK = true;
        Serial.println(F("Peer está online e mensagem enviada e recebida com sucesso"));
    }
    else
    {
        EspNowEntregaOK = false;
        Serial.println(F("Falha no envio. Peer pode estar offline ou MAC incorreto"));
    }

    EspNowEnvioOK = true; // O callback de status de envio foi chamado então o envio está funcionando
}

// Função de callback para receber os dados
void EspNow_CallbackReceber(const uint8_t *mac_addr, const uint8_t *data, int len)
{
    /*
    id de comando + . + executar(0 ou 1)? + . + comando + . + arg1 + . + arg2 + . + argSTR
    valores -1 ou "" serão ignorados
    */

    char msgRecebida[100]; // Variável para armazenar a mensagem recebida

    // Verifica se o comprimento da mensagem recebida é menor que o tamanho da variável 'msgRecebida'
    if (len < sizeof(msgRecebida))
    {
        // Copia a mensagem recebida (armazenada em 'data') para a variável 'msgRecebida'
        memcpy(msgRecebida, data, len);
        // Adiciona o caractere de terminação no final da mensagem recebida para garantir que ela seja uma string válida em C++
        msgRecebida[len] = '\0';
    }

    // Converte a mensagem recebida em uma string
    String msgString = String(msgRecebida);

    // Serial.println("msgRecebida" + msgRecebida);

    // Verifica se os 14 primeiros caracteres são iguais ao identificador de comando
    if (msgString.substring(0, 14) == String(comID))
    {
        // Verifica se o próximo caractere é um ponto
        if (msgString.charAt(14) == '.')
        {
            int nextDotPos;
            int startPos = 15;
            int executar = -1;
            int cmd = -1;
            int arg1 = -1;
            int arg2 = -1;
            String argSTR = "";

            // Converte os caracteres após o ponto em um número e armazena na variável 'executar'
            nextDotPos = msgString.indexOf('.', startPos);
            executar = msgString.substring(startPos, nextDotPos).toInt();
            startPos = nextDotPos + 1;

            if (nextDotPos != -1)
            {
                // Converte os próximos caracteres em um número e armazena na variável 'cmd'
                nextDotPos = msgString.indexOf('.', startPos);
                cmd = msgString.substring(startPos, nextDotPos).toInt();
                startPos = nextDotPos + 1;
            }

            if (nextDotPos != -1)
            {
                // Converte os próximos caracteres em um número e armazena na variável 'arg1'
                nextDotPos = msgString.indexOf('.', startPos);
                arg1 = msgString.substring(startPos, nextDotPos).toInt();
                startPos = nextDotPos + 1;
            }

            if (nextDotPos != -1)
            {
                // Converte os próximos caracteres em um número e armazena na variável 'arg2'
                nextDotPos = msgString.indexOf('.', startPos);
                arg2 = msgString.substring(startPos, nextDotPos).toInt();
                startPos = nextDotPos + 1;
            }

            if (nextDotPos != -1)
            {
                // Obtém todos os próximos caracteres até o fim da mensagem e guarda na variável 'argSTR'
                argSTR = msgString.substring(startPos);
            }

            if (cmd == -1)
            {
                return;
            }

            // Envia 'executar', 'cmd' e argumentos para a função
            COMANDOS(executar, cmd, arg1, arg2, argSTR);
        }
    }
}

void interruptor_luzAmbiente()
{
    if (LuzAmbiente_ON)
    {
        // se a luz estiver acesa, zera o contador para ela ser desligada posteriormente (renova o tempo)
        LuazAmbiente_contador = 0;
    }
    else
    {
        LuazAmbiente_contador = (millis() + LuzAmbiente_tempoMax); // 3 minutos
        LuzAmbiente_ON = true;
    }
}

void interruptor_audio()
{
    bool estadoAtual = !digitalRead(PIN_AUDIO_OUT);
    digitalWrite(PIN_AUDIO_OUT, estadoAtual);
    audio_ON = estadoAtual;
}

void interruptor_aquecedor()
{
    bool estadoAtual = !digitalRead(PIN_AQUECEDOR_OUT);
    digitalWrite(PIN_AQUECEDOR_OUT, estadoAtual);
    aquecedor_ON = estadoAtual;
}

void interruptor_ducheLuz()
{
    bool estadoAtual = !digitalRead(PIN_DUCHE_LUZ_OUT);
    digitalWrite(PIN_DUCHE_LUZ_OUT, estadoAtual);
    ducheLuz_ON = estadoAtual;
}

void LuzAmbiente_Handler()
{
    if (LuzAmbiente_ON)
    {
        digitalWrite(PIN_LUZ_AMBIENTE_OUT, HIGH); // Acende a luz do chao e os led do movel da pia

        if (millis() > LuazAmbiente_contador)
        {
            LuzAmbiente_ON = false;
            LuazAmbiente_contador = 0;
            digitalWrite(PIN_LUZ_AMBIENTE_OUT, LOW); // Apaga a luz do chao e os led do movel da pia
        }

        // acende ou apaga as luzes de estagio inicial
        if (LuzAmbiente_EstagioInicial)
        {
            if ((millis() - LuzAmbiente_EstagioInicial_UltimoON) > LuzAmbiente_EstagioInicial_tempo)
            {
                digitalWrite(PIN_DUCHE_LEDS_OUT, LOW); // apaga luzes da base e nicho da duche
                if (banheiraLed_ON)
                    luz_banheira();                 // apaga a luz da banheira
                LuzAmbiente_EstagioInicial = false; // apagará as luzes ambiente de estagio inicial
            }
            else
            {
                digitalWrite(PIN_DUCHE_LEDS_OUT, HIGH); // acende luzes da base e nicho da duche
                if (!banheiraLed_ON)
                    luz_banheira(); // acende a luz da banheira
            }
        }
    }
}

void LuzAmbiente_PIR()
{
    if (digitalRead(PIN_PIR) == HIGH &&
        (millis() - pir_ultimaLeitura) > pir_intervaloLeitura)
    {
        if (!LuzAmbiente_ON)
        {
            LuazAmbiente_contador = (millis() + LuzAmbiente_tempoMax);
            LuzAmbiente_ON = true;

            // acenderá as luzes ambiente de estagio inicial
            LuzAmbiente_EstagioInicial = true;
            LuzAmbiente_EstagioInicial_UltimoON = millis();
        }
        pir_ultimaLeitura = millis();
    }
}

// Solicita inversão do estado da luz da banheira via ESPNOW.
void luz_banheira()
{

    // Se o EspNow estiver habilitado, tenta enviar o novo estado do rele
    if (EspNowHabilitado)
    {
        // Uso sprintf para formatar a string
        char payload[100];
        sprintf(payload, "%s.%d.%d.%d.%d.%s", comID, 1, 1, -1, -1, "");

        /*
        id de comando + . + executar(0 ou 1)? + . + comando + . + arg1 + . + arg2 + . + argSTR
        valores -1 ou "" serão ignorados
        */

        // Tenta enviar o estado atual do relé para o ESP32 banheiro via EspNow com timeout de 5 segundos
        EspNow_EnviarDadosComTimeout(payload, 5);
    }
}

// SENSOR FLUXO/TEMPERATURA - Leitura de fluxo e temperatura da agua do chuveiro
void Fluxo_handler()
{
    static int numLeituras = 0;
    static int vazaoLeituras = 0;

    if ((millis() - fluxo_previousMillis) >= fluxo_intervaloLeituras)
    {
        if (numLeituras == fluxo_qntLeituras) // Se atingiu o numero de leituras determinado
        {
            vazaoLeituras /= fluxo_qntLeituras;                    // faz a media das leituras
            chuveiroLigado = (vazaoLeituras >= fluxo_vazaoMinima); // define se o chuveiro está ligado

            if (vazaoLeituras >= fluxo_vazaoMinima)
            {
                digitalWrite(PIN_BUZZER, HIGH);
                delay(3000);
                digitalWrite(PIN_BUZZER, LOW);

                while (true)
                {
                    /* code */
                }
            }

            numLeituras = 0;                 // reseta a quantidade de leituras
            vazaoLeituras = 0;               // reseta o valor das leituras
            fluxo_previousMillis = millis(); // marca momento da definição da vazão
        }
        else // Se ainda não atingiu o numero de leituras determinado, faz a leitura e soma o resultado
        {
            vazaoLeituras += (fluxo_numPulsos / 4.5); // Calcula a vazão em L/min e soma à anterior
                                                      // Q = ΔV/Δt. O fator de conversão é 4.5 conforme a datasheet do YF-B7
            numLeituras++;                            // incrementa o numero de leituras em +1
            fluxo_numPulsos = 0;                      // Reinicia o contador de pulsos
        }
    }
}

// Sensor de Fluxo - Interrupção para incrementar o contador de pulsos
void IRAM_ATTR fluxo_contaPulsos()
{
    fluxo_numPulsos++;
}

void NTC_handler()
{
    unsigned long currentMillis = millis();

    if (currentMillis - ntc_ultimoMillis >= ntc_intervalo)
    {
        double Vout, Rt = 0;
        double T, Tc, Tf = 0;

        double adc = 0;

        adc = analogRead(PIN_DUCHE_TEMPERATURA);

        adc = ADC_LUT[(int)adc];

        Vout = adc * ntc_Vs / ntc_adcMax;
        Rt = ntc_R1 * Vout / (ntc_Vs - Vout);

        T = 1 / (1 / ntc_To + log(Rt / ntc_Ro) / ntc_Beta); // Temperature in Kelvin
        Tc = T - 273.15;                                    // Celsius
        Tf = Tc * 9 / 5 + 32;                               // Fahrenheit

        // Adicione a nova leitura à janela e calcule a média móvel
        ntc_sum -= ntc_readings[ntc_currentIndex];
        ntc_readings[ntc_currentIndex] = Tc;
        ntc_sum += Tc;
        ntc_currentIndex = (ntc_currentIndex + 1) % ntc_WINDOW_SIZE;
        double averageTc = ntc_sum / ntc_WINDOW_SIZE;

        if (averageTc > 0)
        {
            // Serial.println(averageTc);
        }

        ntc_ultimoMillis = currentMillis;
    }
}

/********************* DESCARGA *********************/
void DESCARGA_numero1()
{
    DESCARGA_ligar(1);
}

void DESCARGA_mumero2()
{
    DESCARGA_ligar(2);
}

void DESCARGA_onDemand()
{
    DESCARGA_ligar(3);
}

void DESCARGA_onDemand_fim()
{
    // desativa o modo onDemand
    descarga_ModoOnDemand = false;

    // define o tempo de espera = o tempo que ficou pressionado
    descarga_tempoEspera = millis() - descarga_inicioTempoEspera;
}

void DESCARGA_handler()
{
    // se a descarga estiver acionada por demasiado tempo, pode ser uma pane.
    if (digitalRead(PIN_DESCARGA_OUT) == HIGH && (millis() - descarga_inicioTempoEspera) > descarga_tempoAlarme)
    {
        // tento fechar a descarga, desativar a leitura do pino e desabilitar a descarga
        digitalWrite(PIN_BUZZER, HIGH);
        digitalWrite(PIN_DESCARGA_OUT, LOW);
        delay(descarga_tempoMax + descarga_MargemSeguranca);
        pinMode(PIN_DESCARGA_OUT, INPUT);
        descarga_fechando = false;
        descarga_abrindo = false;
        descarga_habilitada = false;
        delay(2000);

        // se a descarga ainda estiver aberta, reinicio o esp
        if (digitalRead(PIN_DESCARGA_OUT) == HIGH)
        {
            ESP.restart();
        }
    }

    // se a descarga estiver habilitada
    if (descarga_habilitada)
    {
        // Se a descarga está habilitada e livre, permite novos clicks
        if (descarga_abrindo == false && descarga_fechando == false)
        {
            bt_descarga.tick(); // Handler para o botao da descarga.
        }
        else // se a descarga estiver em uso
        {
            // se estiver em modo OnDemand
            if (descarga_ModoOnDemand)
            {
                // os eventos de click só sao capturados quando há o tick
                // como estou à espera de ser avisado que o  botao foi liberado,
                // preciso manter o tick rodando
                bt_descarga.tick();

                // se atingiu o tempo maximo + margem de segurança
                if ((millis() - descarga_inicioTempoEspera) > (descarga_tempoEspera + descarga_MargemSeguranca))
                {
                    digitalWrite(PIN_BUZZER, HIGH);
                    // desativa o modo onDemand
                    descarga_ModoOnDemand = false;
                }
            }
            else // Se não estiver em modo onDemand
            {
                // se atingiu o tempo de abertura/fechamento
                if ((millis() - descarga_inicioTempoEspera) > descarga_tempoEspera)
                {
                    // se atingiu o tempo de abertura
                    if (descarga_abrindo)
                    {
                        DESCARGA_desligar();
                    }

                    // se atingiu o tempo de fechamento + margem de segurança
                    if (descarga_fechando &&
                        (millis() - descarga_inicioTempoEspera) > (descarga_tempoEspera + descarga_MargemSeguranca))
                    {
                        DESCARGA_liberar();
                    }
                }
            }
        }
    }
}

// Liga a eletrovalvula
void DESCARGA_ligar(byte modo)
{
    switch (modo)
    {
    case 1: // mijão
        descarga_tempoEspera = descarga_tempo1;
        break;

    case 2: // cagão
        descarga_tempoEspera = descarga_tempo2;
        break;
    case 3: // ondemand
        descarga_tempoEspera = descarga_tempoMax;
        descarga_ModoOnDemand = true;
        break;

    default:
        break;
    }

    descarga_ON = true;
    descarga_inicioTempoEspera = millis();
    descarga_abrindo = true;
    descarga_fechando = false;
    digitalWrite(PIN_DESCARGA_OUT, HIGH);
}

void DESCARGA_desligar()
{
    digitalWrite(PIN_DESCARGA_OUT, LOW);
    descarga_fechando = true;
    descarga_abrindo = false;
    descarga_inicioTempoEspera = millis();
}

void DESCARGA_liberar()
{
    descarga_ON = false;
    descarga_fechando = false;
    descarga_abrindo = false;
}

/// <summary>
/// /// Comandos que podem ser executados/interpretados
/// </summary>
/// <param name="executar">0 ou 1</param>
/// <param name="cmd">0 ou 1</param>
/// <param name="arg1">0 ou 1</param>
/// <param name="arg2">0 ou 1</param>
/// <param name="argSTR">String</param>
void COMANDOS(bool executar, int cmd, int arg1, int arg2, String argSTR)
{
    switch (cmd)
    {
    case 0: // POSSIVEL ERRO
        // Algumas funções como atoi retornam zero quando encontram erro
        // Por isto evito usar a case 0
        break;

    case 1:           // ALTERAR O ESTADO DA LUZ DA BANHEIRA
        if (executar) // alterar
        {
            luz_banheira();
        }
        else // atualizar
        {
            banheiraLed_ON = arg1;
        };
        break;

    case 2:
        break;
    case 3:
        break;
    case 4:
        break;
    case 5:
        break;

    default:
        break;
    }
}